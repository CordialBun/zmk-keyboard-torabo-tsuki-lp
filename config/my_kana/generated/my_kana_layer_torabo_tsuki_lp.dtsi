// Generated by tools/generate_my_kana_zmk.py. Do not edit manually.

        kana_layer {
            display-name = "Kana";
            bindings = <
&trans               &trans               &trans               &trans               &trans               &trans               &trans               &trans               &trans               &trans               &trans               &trans
&trans               &my_kana_se_key      &my_kana_sa_key      &my_kana_ha_key      &my_kana_te_key      &my_kana_wo_key      &my_kana_ti_key      &my_kana_tu_key      &my_kana_ku_key      &my_kana_xtu_key     &my_kana_hi_key      &trans
&trans               &my_kana_ka_key      &my_kana_to_key      &my_kana_ta_key      &my_kana_no_key      &my_kana_ni_key      &trans               &trans               &my_kana_comma_key   &my_kana_nn_key      &my_kana_i_key       &my_kana_u_key       &my_kana_si_key      &trans
&trans               &my_kana_yo_key      &my_kana_da_key      &my_kana_do_key      &my_kana_ga_key      &my_kana_ra_key      &trans               &trans               &my_kana_wa_key      &my_kana_ru_key      &my_kana_long_key    &my_kana_re_key      &my_kana_e_key       &trans
&trans               &trans               &trans               &trans               &trans               &trans               &trans               &trans               &trans               &trans               &trans               &trans               &trans               &my_kana_off
            >;
        };

