// Generated by tools/generate_my_kana_zmk.py. Do not edit manually.

        my_kana_se: my_kana_se {
            compatible = "zmk,behavior-macro";
            #binding-cells = <0>;
            wait-ms = <MY_KANA_MACRO_WAIT_MS>;
            tap-ms = <MY_KANA_MACRO_TAP_MS>;
            bindings = <&kp S &kp E>;
        };

        my_kana_sa: my_kana_sa {
            compatible = "zmk,behavior-macro";
            #binding-cells = <0>;
            wait-ms = <MY_KANA_MACRO_WAIT_MS>;
            tap-ms = <MY_KANA_MACRO_TAP_MS>;
            bindings = <&kp S &kp A>;
        };

        my_kana_ha: my_kana_ha {
            compatible = "zmk,behavior-macro";
            #binding-cells = <0>;
            wait-ms = <MY_KANA_MACRO_WAIT_MS>;
            tap-ms = <MY_KANA_MACRO_TAP_MS>;
            bindings = <&kp H &kp A>;
        };

        my_kana_te: my_kana_te {
            compatible = "zmk,behavior-macro";
            #binding-cells = <0>;
            wait-ms = <MY_KANA_MACRO_WAIT_MS>;
            tap-ms = <MY_KANA_MACRO_TAP_MS>;
            bindings = <&kp T &kp E>;
        };

        my_kana_wo: my_kana_wo {
            compatible = "zmk,behavior-macro";
            #binding-cells = <0>;
            wait-ms = <MY_KANA_MACRO_WAIT_MS>;
            tap-ms = <MY_KANA_MACRO_TAP_MS>;
            bindings = <&kp W &kp O>;
        };

        my_kana_ti: my_kana_ti {
            compatible = "zmk,behavior-macro";
            #binding-cells = <0>;
            wait-ms = <MY_KANA_MACRO_WAIT_MS>;
            tap-ms = <MY_KANA_MACRO_TAP_MS>;
            bindings = <&kp T &kp I>;
        };

        my_kana_tu: my_kana_tu {
            compatible = "zmk,behavior-macro";
            #binding-cells = <0>;
            wait-ms = <MY_KANA_MACRO_WAIT_MS>;
            tap-ms = <MY_KANA_MACRO_TAP_MS>;
            bindings = <&kp T &kp U>;
        };

        my_kana_ku: my_kana_ku {
            compatible = "zmk,behavior-macro";
            #binding-cells = <0>;
            wait-ms = <MY_KANA_MACRO_WAIT_MS>;
            tap-ms = <MY_KANA_MACRO_TAP_MS>;
            bindings = <&kp K &kp U>;
        };

        my_kana_xtu: my_kana_xtu {
            compatible = "zmk,behavior-macro";
            #binding-cells = <0>;
            wait-ms = <MY_KANA_MACRO_WAIT_MS>;
            tap-ms = <MY_KANA_MACRO_TAP_MS>;
            bindings = <&kp X &kp T &kp U>;
        };

        my_kana_hi: my_kana_hi {
            compatible = "zmk,behavior-macro";
            #binding-cells = <0>;
            wait-ms = <MY_KANA_MACRO_WAIT_MS>;
            tap-ms = <MY_KANA_MACRO_TAP_MS>;
            bindings = <&kp H &kp I>;
        };

        my_kana_ka: my_kana_ka {
            compatible = "zmk,behavior-macro";
            #binding-cells = <0>;
            wait-ms = <MY_KANA_MACRO_WAIT_MS>;
            tap-ms = <MY_KANA_MACRO_TAP_MS>;
            bindings = <&kp K &kp A>;
        };

        my_kana_to: my_kana_to {
            compatible = "zmk,behavior-macro";
            #binding-cells = <0>;
            wait-ms = <MY_KANA_MACRO_WAIT_MS>;
            tap-ms = <MY_KANA_MACRO_TAP_MS>;
            bindings = <&kp T &kp O>;
        };

        my_kana_ta: my_kana_ta {
            compatible = "zmk,behavior-macro";
            #binding-cells = <0>;
            wait-ms = <MY_KANA_MACRO_WAIT_MS>;
            tap-ms = <MY_KANA_MACRO_TAP_MS>;
            bindings = <&kp T &kp A>;
        };

        my_kana_no: my_kana_no {
            compatible = "zmk,behavior-macro";
            #binding-cells = <0>;
            wait-ms = <MY_KANA_MACRO_WAIT_MS>;
            tap-ms = <MY_KANA_MACRO_TAP_MS>;
            bindings = <&kp N &kp O>;
        };

        my_kana_ni: my_kana_ni {
            compatible = "zmk,behavior-macro";
            #binding-cells = <0>;
            wait-ms = <MY_KANA_MACRO_WAIT_MS>;
            tap-ms = <MY_KANA_MACRO_TAP_MS>;
            bindings = <&kp N &kp I>;
        };

        my_kana_comma: my_kana_comma {
            compatible = "zmk,behavior-macro";
            #binding-cells = <0>;
            wait-ms = <MY_KANA_MACRO_WAIT_MS>;
            tap-ms = <MY_KANA_MACRO_TAP_MS>;
            bindings = <&kp COMMA>;
        };

        my_kana_nn: my_kana_nn {
            compatible = "zmk,behavior-macro";
            #binding-cells = <0>;
            wait-ms = <MY_KANA_MACRO_WAIT_MS>;
            tap-ms = <MY_KANA_MACRO_TAP_MS>;
            bindings = <&kp N &kp N>;
        };

        my_kana_i: my_kana_i {
            compatible = "zmk,behavior-macro";
            #binding-cells = <0>;
            wait-ms = <MY_KANA_MACRO_WAIT_MS>;
            tap-ms = <MY_KANA_MACRO_TAP_MS>;
            bindings = <&kp I>;
        };

        my_kana_u: my_kana_u {
            compatible = "zmk,behavior-macro";
            #binding-cells = <0>;
            wait-ms = <MY_KANA_MACRO_WAIT_MS>;
            tap-ms = <MY_KANA_MACRO_TAP_MS>;
            bindings = <&kp U>;
        };

        my_kana_si: my_kana_si {
            compatible = "zmk,behavior-macro";
            #binding-cells = <0>;
            wait-ms = <MY_KANA_MACRO_WAIT_MS>;
            tap-ms = <MY_KANA_MACRO_TAP_MS>;
            bindings = <&kp S &kp I>;
        };

        my_kana_yo: my_kana_yo {
            compatible = "zmk,behavior-macro";
            #binding-cells = <0>;
            wait-ms = <MY_KANA_MACRO_WAIT_MS>;
            tap-ms = <MY_KANA_MACRO_TAP_MS>;
            bindings = <&kp Y &kp O>;
        };

        my_kana_da: my_kana_da {
            compatible = "zmk,behavior-macro";
            #binding-cells = <0>;
            wait-ms = <MY_KANA_MACRO_WAIT_MS>;
            tap-ms = <MY_KANA_MACRO_TAP_MS>;
            bindings = <&kp D &kp A>;
        };

        my_kana_do: my_kana_do {
            compatible = "zmk,behavior-macro";
            #binding-cells = <0>;
            wait-ms = <MY_KANA_MACRO_WAIT_MS>;
            tap-ms = <MY_KANA_MACRO_TAP_MS>;
            bindings = <&kp D &kp O>;
        };

        my_kana_ga: my_kana_ga {
            compatible = "zmk,behavior-macro";
            #binding-cells = <0>;
            wait-ms = <MY_KANA_MACRO_WAIT_MS>;
            tap-ms = <MY_KANA_MACRO_TAP_MS>;
            bindings = <&kp G &kp A>;
        };

        my_kana_ra: my_kana_ra {
            compatible = "zmk,behavior-macro";
            #binding-cells = <0>;
            wait-ms = <MY_KANA_MACRO_WAIT_MS>;
            tap-ms = <MY_KANA_MACRO_TAP_MS>;
            bindings = <&kp R &kp A>;
        };

        my_kana_wa: my_kana_wa {
            compatible = "zmk,behavior-macro";
            #binding-cells = <0>;
            wait-ms = <MY_KANA_MACRO_WAIT_MS>;
            tap-ms = <MY_KANA_MACRO_TAP_MS>;
            bindings = <&kp W &kp A>;
        };

        my_kana_ru: my_kana_ru {
            compatible = "zmk,behavior-macro";
            #binding-cells = <0>;
            wait-ms = <MY_KANA_MACRO_WAIT_MS>;
            tap-ms = <MY_KANA_MACRO_TAP_MS>;
            bindings = <&kp R &kp U>;
        };

        my_kana_long: my_kana_long {
            compatible = "zmk,behavior-macro";
            #binding-cells = <0>;
            wait-ms = <MY_KANA_MACRO_WAIT_MS>;
            tap-ms = <MY_KANA_MACRO_TAP_MS>;
            bindings = <&kp MINUS>;
        };

        my_kana_re: my_kana_re {
            compatible = "zmk,behavior-macro";
            #binding-cells = <0>;
            wait-ms = <MY_KANA_MACRO_WAIT_MS>;
            tap-ms = <MY_KANA_MACRO_TAP_MS>;
            bindings = <&kp R &kp E>;
        };

        my_kana_e: my_kana_e {
            compatible = "zmk,behavior-macro";
            #binding-cells = <0>;
            wait-ms = <MY_KANA_MACRO_WAIT_MS>;
            tap-ms = <MY_KANA_MACRO_TAP_MS>;
            bindings = <&kp E>;
        };

        my_kana_di: my_kana_di {
            compatible = "zmk,behavior-macro";
            #binding-cells = <0>;
            wait-ms = <MY_KANA_MACRO_WAIT_MS>;
            tap-ms = <MY_KANA_MACRO_TAP_MS>;
            bindings = <&kp D &kp I>;
        };

        my_kana_di_pass: my_kana_di_pass {
            compatible = "zmk,behavior-macro";
            #binding-cells = <0>;
            wait-ms = <MY_KANA_MACRO_WAIT_MS>;
            tap-ms = <MY_KANA_MACRO_TAP_MS>;
            bindings = <&kp K &kp Q>;
        };

        my_kana_ge: my_kana_ge {
            compatible = "zmk,behavior-macro";
            #binding-cells = <0>;
            wait-ms = <MY_KANA_MACRO_WAIT_MS>;
            tap-ms = <MY_KANA_MACRO_TAP_MS>;
            bindings = <&kp G &kp E>;
        };

        my_kana_ge_pass: my_kana_ge_pass {
            compatible = "zmk,behavior-macro";
            #binding-cells = <0>;
            wait-ms = <MY_KANA_MACRO_WAIT_MS>;
            tap-ms = <MY_KANA_MACRO_TAP_MS>;
            bindings = <&kp K &kp W>;
        };

        my_kana_ho: my_kana_ho {
            compatible = "zmk,behavior-macro";
            #binding-cells = <0>;
            wait-ms = <MY_KANA_MACRO_WAIT_MS>;
            tap-ms = <MY_KANA_MACRO_TAP_MS>;
            bindings = <&kp H &kp O>;
        };

        my_kana_ho_pass: my_kana_ho_pass {
            compatible = "zmk,behavior-macro";
            #binding-cells = <0>;
            wait-ms = <MY_KANA_MACRO_WAIT_MS>;
            tap-ms = <MY_KANA_MACRO_TAP_MS>;
            bindings = <&kp K &kp E>;
        };

        my_kana_gi: my_kana_gi {
            compatible = "zmk,behavior-macro";
            #binding-cells = <0>;
            wait-ms = <MY_KANA_MACRO_WAIT_MS>;
            tap-ms = <MY_KANA_MACRO_TAP_MS>;
            bindings = <&kp G &kp I>;
        };

        my_kana_gi_pass: my_kana_gi_pass {
            compatible = "zmk,behavior-macro";
            #binding-cells = <0>;
            wait-ms = <MY_KANA_MACRO_WAIT_MS>;
            tap-ms = <MY_KANA_MACRO_TAP_MS>;
            bindings = <&kp K &kp R>;
        };

        my_kana_ze: my_kana_ze {
            compatible = "zmk,behavior-macro";
            #binding-cells = <0>;
            wait-ms = <MY_KANA_MACRO_WAIT_MS>;
            tap-ms = <MY_KANA_MACRO_TAP_MS>;
            bindings = <&kp Z &kp E>;
        };

        my_kana_ze_pass: my_kana_ze_pass {
            compatible = "zmk,behavior-macro";
            #binding-cells = <0>;
            wait-ms = <MY_KANA_MACRO_WAIT_MS>;
            tap-ms = <MY_KANA_MACRO_TAP_MS>;
            bindings = <&kp K &kp T>;
        };

        my_kana_du: my_kana_du {
            compatible = "zmk,behavior-macro";
            #binding-cells = <0>;
            wait-ms = <MY_KANA_MACRO_WAIT_MS>;
            tap-ms = <MY_KANA_MACRO_TAP_MS>;
            bindings = <&kp D &kp U>;
        };

        my_kana_du_pass: my_kana_du_pass {
            compatible = "zmk,behavior-macro";
            #binding-cells = <0>;
            wait-ms = <MY_KANA_MACRO_WAIT_MS>;
            tap-ms = <MY_KANA_MACRO_TAP_MS>;
            bindings = <&kp D &kp Y>;
        };

        my_kana_yu: my_kana_yu {
            compatible = "zmk,behavior-macro";
            #binding-cells = <0>;
            wait-ms = <MY_KANA_MACRO_WAIT_MS>;
            tap-ms = <MY_KANA_MACRO_TAP_MS>;
            bindings = <&kp Y &kp U>;
        };

        my_kana_yu_pass: my_kana_yu_pass {
            compatible = "zmk,behavior-macro";
            #binding-cells = <0>;
            wait-ms = <MY_KANA_MACRO_WAIT_MS>;
            tap-ms = <MY_KANA_MACRO_TAP_MS>;
            bindings = <&kp D &kp U>;
        };

        my_kana_hu: my_kana_hu {
            compatible = "zmk,behavior-macro";
            #binding-cells = <0>;
            wait-ms = <MY_KANA_MACRO_WAIT_MS>;
            tap-ms = <MY_KANA_MACRO_TAP_MS>;
            bindings = <&kp H &kp U>;
        };

        my_kana_hu_pass: my_kana_hu_pass {
            compatible = "zmk,behavior-macro";
            #binding-cells = <0>;
            wait-ms = <MY_KANA_MACRO_WAIT_MS>;
            tap-ms = <MY_KANA_MACRO_TAP_MS>;
            bindings = <&kp D &kp I>;
        };

        my_kana_bi: my_kana_bi {
            compatible = "zmk,behavior-macro";
            #binding-cells = <0>;
            wait-ms = <MY_KANA_MACRO_WAIT_MS>;
            tap-ms = <MY_KANA_MACRO_TAP_MS>;
            bindings = <&kp B &kp I>;
        };

        my_kana_bi_pass: my_kana_bi_pass {
            compatible = "zmk,behavior-macro";
            #binding-cells = <0>;
            wait-ms = <MY_KANA_MACRO_WAIT_MS>;
            tap-ms = <MY_KANA_MACRO_TAP_MS>;
            bindings = <&kp D &kp O>;
        };

        my_kana_vu: my_kana_vu {
            compatible = "zmk,behavior-macro";
            #binding-cells = <0>;
            wait-ms = <MY_KANA_MACRO_WAIT_MS>;
            tap-ms = <MY_KANA_MACRO_TAP_MS>;
            bindings = <&kp V &kp U>;
        };

        my_kana_vu_pass: my_kana_vu_pass {
            compatible = "zmk,behavior-macro";
            #binding-cells = <0>;
            wait-ms = <MY_KANA_MACRO_WAIT_MS>;
            tap-ms = <MY_KANA_MACRO_TAP_MS>;
            bindings = <&kp D &kp P>;
        };

        my_kana_ke: my_kana_ke {
            compatible = "zmk,behavior-macro";
            #binding-cells = <0>;
            wait-ms = <MY_KANA_MACRO_WAIT_MS>;
            tap-ms = <MY_KANA_MACRO_TAP_MS>;
            bindings = <&kp K &kp E>;
        };

        my_kana_ke_pass: my_kana_ke_pass {
            compatible = "zmk,behavior-macro";
            #binding-cells = <0>;
            wait-ms = <MY_KANA_MACRO_WAIT_MS>;
            tap-ms = <MY_KANA_MACRO_TAP_MS>;
            bindings = <&kp K &kp A>;
        };

        my_kana_na: my_kana_na {
            compatible = "zmk,behavior-macro";
            #binding-cells = <0>;
            wait-ms = <MY_KANA_MACRO_WAIT_MS>;
            tap-ms = <MY_KANA_MACRO_TAP_MS>;
            bindings = <&kp N &kp A>;
        };

        my_kana_na_pass: my_kana_na_pass {
            compatible = "zmk,behavior-macro";
            #binding-cells = <0>;
            wait-ms = <MY_KANA_MACRO_WAIT_MS>;
            tap-ms = <MY_KANA_MACRO_TAP_MS>;
            bindings = <&kp K &kp S>;
        };

        my_kana_ko: my_kana_ko {
            compatible = "zmk,behavior-macro";
            #binding-cells = <0>;
            wait-ms = <MY_KANA_MACRO_WAIT_MS>;
            tap-ms = <MY_KANA_MACRO_TAP_MS>;
            bindings = <&kp K &kp O>;
        };

        my_kana_ko_pass: my_kana_ko_pass {
            compatible = "zmk,behavior-macro";
            #binding-cells = <0>;
            wait-ms = <MY_KANA_MACRO_WAIT_MS>;
            tap-ms = <MY_KANA_MACRO_TAP_MS>;
            bindings = <&kp K &kp D>;
        };

        my_kana_period: my_kana_period {
            compatible = "zmk,behavior-macro";
            #binding-cells = <0>;
            wait-ms = <MY_KANA_MACRO_WAIT_MS>;
            tap-ms = <MY_KANA_MACRO_TAP_MS>;
            bindings = <&kp DOT>;
        };

        my_kana_period_pass: my_kana_period_pass {
            compatible = "zmk,behavior-macro";
            #binding-cells = <0>;
            wait-ms = <MY_KANA_MACRO_WAIT_MS>;
            tap-ms = <MY_KANA_MACRO_TAP_MS>;
            bindings = <&kp K &kp F>;
        };

        my_kana_zi: my_kana_zi {
            compatible = "zmk,behavior-macro";
            #binding-cells = <0>;
            wait-ms = <MY_KANA_MACRO_WAIT_MS>;
            tap-ms = <MY_KANA_MACRO_TAP_MS>;
            bindings = <&kp Z &kp I>;
        };

        my_kana_zi_pass: my_kana_zi_pass {
            compatible = "zmk,behavior-macro";
            #binding-cells = <0>;
            wait-ms = <MY_KANA_MACRO_WAIT_MS>;
            tap-ms = <MY_KANA_MACRO_TAP_MS>;
            bindings = <&kp K &kp G>;
        };

        my_kana_so: my_kana_so {
            compatible = "zmk,behavior-macro";
            #binding-cells = <0>;
            wait-ms = <MY_KANA_MACRO_WAIT_MS>;
            tap-ms = <MY_KANA_MACRO_TAP_MS>;
            bindings = <&kp S &kp O>;
        };

        my_kana_so_pass: my_kana_so_pass {
            compatible = "zmk,behavior-macro";
            #binding-cells = <0>;
            wait-ms = <MY_KANA_MACRO_WAIT_MS>;
            tap-ms = <MY_KANA_MACRO_TAP_MS>;
            bindings = <&kp D &kp H>;
        };

        my_kana_o: my_kana_o {
            compatible = "zmk,behavior-macro";
            #binding-cells = <0>;
            wait-ms = <MY_KANA_MACRO_WAIT_MS>;
            tap-ms = <MY_KANA_MACRO_TAP_MS>;
            bindings = <&kp O>;
        };

        my_kana_o_pass: my_kana_o_pass {
            compatible = "zmk,behavior-macro";
            #binding-cells = <0>;
            wait-ms = <MY_KANA_MACRO_WAIT_MS>;
            tap-ms = <MY_KANA_MACRO_TAP_MS>;
            bindings = <&kp D &kp J>;
        };

        my_kana_a: my_kana_a {
            compatible = "zmk,behavior-macro";
            #binding-cells = <0>;
            wait-ms = <MY_KANA_MACRO_WAIT_MS>;
            tap-ms = <MY_KANA_MACRO_TAP_MS>;
            bindings = <&kp A>;
        };

        my_kana_a_pass: my_kana_a_pass {
            compatible = "zmk,behavior-macro";
            #binding-cells = <0>;
            wait-ms = <MY_KANA_MACRO_WAIT_MS>;
            tap-ms = <MY_KANA_MACRO_TAP_MS>;
            bindings = <&kp D &kp SEMI>;
        };

        my_kana_pi: my_kana_pi {
            compatible = "zmk,behavior-macro";
            #binding-cells = <0>;
            wait-ms = <MY_KANA_MACRO_WAIT_MS>;
            tap-ms = <MY_KANA_MACRO_TAP_MS>;
            bindings = <&kp P &kp I>;
        };

        my_kana_pi_pass: my_kana_pi_pass {
            compatible = "zmk,behavior-macro";
            #binding-cells = <0>;
            wait-ms = <MY_KANA_MACRO_WAIT_MS>;
            tap-ms = <MY_KANA_MACRO_TAP_MS>;
            bindings = <&kp K &kp Z>;
        };

        my_kana_po: my_kana_po {
            compatible = "zmk,behavior-macro";
            #binding-cells = <0>;
            wait-ms = <MY_KANA_MACRO_WAIT_MS>;
            tap-ms = <MY_KANA_MACRO_TAP_MS>;
            bindings = <&kp P &kp O>;
        };

        my_kana_po_pass: my_kana_po_pass {
            compatible = "zmk,behavior-macro";
            #binding-cells = <0>;
            wait-ms = <MY_KANA_MACRO_WAIT_MS>;
            tap-ms = <MY_KANA_MACRO_TAP_MS>;
            bindings = <&kp K &kp X>;
        };

        my_kana_ne: my_kana_ne {
            compatible = "zmk,behavior-macro";
            #binding-cells = <0>;
            wait-ms = <MY_KANA_MACRO_WAIT_MS>;
            tap-ms = <MY_KANA_MACRO_TAP_MS>;
            bindings = <&kp N &kp E>;
        };

        my_kana_ne_pass: my_kana_ne_pass {
            compatible = "zmk,behavior-macro";
            #binding-cells = <0>;
            wait-ms = <MY_KANA_MACRO_WAIT_MS>;
            tap-ms = <MY_KANA_MACRO_TAP_MS>;
            bindings = <&kp K &kp C>;
        };

        my_kana_ba: my_kana_ba {
            compatible = "zmk,behavior-macro";
            #binding-cells = <0>;
            wait-ms = <MY_KANA_MACRO_WAIT_MS>;
            tap-ms = <MY_KANA_MACRO_TAP_MS>;
            bindings = <&kp B &kp A>;
        };

        my_kana_ba_pass: my_kana_ba_pass {
            compatible = "zmk,behavior-macro";
            #binding-cells = <0>;
            wait-ms = <MY_KANA_MACRO_WAIT_MS>;
            tap-ms = <MY_KANA_MACRO_TAP_MS>;
            bindings = <&kp K &kp V>;
        };

        my_kana_pa: my_kana_pa {
            compatible = "zmk,behavior-macro";
            #binding-cells = <0>;
            wait-ms = <MY_KANA_MACRO_WAIT_MS>;
            tap-ms = <MY_KANA_MACRO_TAP_MS>;
            bindings = <&kp P &kp A>;
        };

        my_kana_pa_pass: my_kana_pa_pass {
            compatible = "zmk,behavior-macro";
            #binding-cells = <0>;
            wait-ms = <MY_KANA_MACRO_WAIT_MS>;
            tap-ms = <MY_KANA_MACRO_TAP_MS>;
            bindings = <&kp K &kp B>;
        };

        my_kana_nu: my_kana_nu {
            compatible = "zmk,behavior-macro";
            #binding-cells = <0>;
            wait-ms = <MY_KANA_MACRO_WAIT_MS>;
            tap-ms = <MY_KANA_MACRO_TAP_MS>;
            bindings = <&kp N &kp U>;
        };

        my_kana_nu_pass: my_kana_nu_pass {
            compatible = "zmk,behavior-macro";
            #binding-cells = <0>;
            wait-ms = <MY_KANA_MACRO_WAIT_MS>;
            tap-ms = <MY_KANA_MACRO_TAP_MS>;
            bindings = <&kp D &kp N>;
        };

        my_kana_mi: my_kana_mi {
            compatible = "zmk,behavior-macro";
            #binding-cells = <0>;
            wait-ms = <MY_KANA_MACRO_WAIT_MS>;
            tap-ms = <MY_KANA_MACRO_TAP_MS>;
            bindings = <&kp M &kp I>;
        };

        my_kana_mi_pass: my_kana_mi_pass {
            compatible = "zmk,behavior-macro";
            #binding-cells = <0>;
            wait-ms = <MY_KANA_MACRO_WAIT_MS>;
            tap-ms = <MY_KANA_MACRO_TAP_MS>;
            bindings = <&kp D &kp M>;
        };

        my_kana_gu: my_kana_gu {
            compatible = "zmk,behavior-macro";
            #binding-cells = <0>;
            wait-ms = <MY_KANA_MACRO_WAIT_MS>;
            tap-ms = <MY_KANA_MACRO_TAP_MS>;
            bindings = <&kp G &kp U>;
        };

        my_kana_gu_pass: my_kana_gu_pass {
            compatible = "zmk,behavior-macro";
            #binding-cells = <0>;
            wait-ms = <MY_KANA_MACRO_WAIT_MS>;
            tap-ms = <MY_KANA_MACRO_TAP_MS>;
            bindings = <&kp D &kp COMMA>;
        };

        my_kana_dhi: my_kana_dhi {
            compatible = "zmk,behavior-macro";
            #binding-cells = <0>;
            wait-ms = <MY_KANA_MACRO_WAIT_MS>;
            tap-ms = <MY_KANA_MACRO_TAP_MS>;
            bindings = <&kp D &kp H &kp I>;
        };

        my_kana_dhi_pass: my_kana_dhi_pass {
            compatible = "zmk,behavior-macro";
            #binding-cells = <0>;
            wait-ms = <MY_KANA_MACRO_WAIT_MS>;
            tap-ms = <MY_KANA_MACRO_TAP_MS>;
            bindings = <&kp D &kp DOT>;
        };

        my_kana_pu: my_kana_pu {
            compatible = "zmk,behavior-macro";
            #binding-cells = <0>;
            wait-ms = <MY_KANA_MACRO_WAIT_MS>;
            tap-ms = <MY_KANA_MACRO_TAP_MS>;
            bindings = <&kp P &kp U>;
        };

        my_kana_pu_pass: my_kana_pu_pass {
            compatible = "zmk,behavior-macro";
            #binding-cells = <0>;
            wait-ms = <MY_KANA_MACRO_WAIT_MS>;
            tap-ms = <MY_KANA_MACRO_TAP_MS>;
            bindings = <&kp D &kp SLASH>;
        };

        my_kana_xa: my_kana_xa {
            compatible = "zmk,behavior-macro";
            #binding-cells = <0>;
            wait-ms = <MY_KANA_MACRO_WAIT_MS>;
            tap-ms = <MY_KANA_MACRO_TAP_MS>;
            bindings = <&kp X &kp A>;
        };

        my_kana_xa_pass: my_kana_xa_pass {
            compatible = "zmk,behavior-macro";
            #binding-cells = <0>;
            wait-ms = <MY_KANA_MACRO_WAIT_MS>;
            tap-ms = <MY_KANA_MACRO_TAP_MS>;
            bindings = <&kp L &kp Q>;
        };

        my_kana_me: my_kana_me {
            compatible = "zmk,behavior-macro";
            #binding-cells = <0>;
            wait-ms = <MY_KANA_MACRO_WAIT_MS>;
            tap-ms = <MY_KANA_MACRO_TAP_MS>;
            bindings = <&kp M &kp E>;
        };

        my_kana_me_pass: my_kana_me_pass {
            compatible = "zmk,behavior-macro";
            #binding-cells = <0>;
            wait-ms = <MY_KANA_MACRO_WAIT_MS>;
            tap-ms = <MY_KANA_MACRO_TAP_MS>;
            bindings = <&kp L &kp W>;
        };

        my_kana_bu: my_kana_bu {
            compatible = "zmk,behavior-macro";
            #binding-cells = <0>;
            wait-ms = <MY_KANA_MACRO_WAIT_MS>;
            tap-ms = <MY_KANA_MACRO_TAP_MS>;
            bindings = <&kp B &kp U>;
        };

        my_kana_bu_pass: my_kana_bu_pass {
            compatible = "zmk,behavior-macro";
            #binding-cells = <0>;
            wait-ms = <MY_KANA_MACRO_WAIT_MS>;
            tap-ms = <MY_KANA_MACRO_TAP_MS>;
            bindings = <&kp L &kp E>;
        };

        my_kana_za: my_kana_za {
            compatible = "zmk,behavior-macro";
            #binding-cells = <0>;
            wait-ms = <MY_KANA_MACRO_WAIT_MS>;
            tap-ms = <MY_KANA_MACRO_TAP_MS>;
            bindings = <&kp Z &kp A>;
        };

        my_kana_za_pass: my_kana_za_pass {
            compatible = "zmk,behavior-macro";
            #binding-cells = <0>;
            wait-ms = <MY_KANA_MACRO_WAIT_MS>;
            tap-ms = <MY_KANA_MACRO_TAP_MS>;
            bindings = <&kp L &kp R>;
        };

        my_kana_xi: my_kana_xi {
            compatible = "zmk,behavior-macro";
            #binding-cells = <0>;
            wait-ms = <MY_KANA_MACRO_WAIT_MS>;
            tap-ms = <MY_KANA_MACRO_TAP_MS>;
            bindings = <&kp X &kp I>;
        };

        my_kana_xi_pass: my_kana_xi_pass {
            compatible = "zmk,behavior-macro";
            #binding-cells = <0>;
            wait-ms = <MY_KANA_MACRO_WAIT_MS>;
            tap-ms = <MY_KANA_MACRO_TAP_MS>;
            bindings = <&kp L &kp T>;
        };

        my_kana_xu: my_kana_xu {
            compatible = "zmk,behavior-macro";
            #binding-cells = <0>;
            wait-ms = <MY_KANA_MACRO_WAIT_MS>;
            tap-ms = <MY_KANA_MACRO_TAP_MS>;
            bindings = <&kp X &kp U>;
        };

        my_kana_xu_pass: my_kana_xu_pass {
            compatible = "zmk,behavior-macro";
            #binding-cells = <0>;
            wait-ms = <MY_KANA_MACRO_WAIT_MS>;
            tap-ms = <MY_KANA_MACRO_TAP_MS>;
            bindings = <&kp S &kp Y>;
        };

        my_kana_zo: my_kana_zo {
            compatible = "zmk,behavior-macro";
            #binding-cells = <0>;
            wait-ms = <MY_KANA_MACRO_WAIT_MS>;
            tap-ms = <MY_KANA_MACRO_TAP_MS>;
            bindings = <&kp Z &kp O>;
        };

        my_kana_zo_pass: my_kana_zo_pass {
            compatible = "zmk,behavior-macro";
            #binding-cells = <0>;
            wait-ms = <MY_KANA_MACRO_WAIT_MS>;
            tap-ms = <MY_KANA_MACRO_TAP_MS>;
            bindings = <&kp S &kp U>;
        };

        my_kana_go: my_kana_go {
            compatible = "zmk,behavior-macro";
            #binding-cells = <0>;
            wait-ms = <MY_KANA_MACRO_WAIT_MS>;
            tap-ms = <MY_KANA_MACRO_TAP_MS>;
            bindings = <&kp G &kp O>;
        };

        my_kana_go_pass: my_kana_go_pass {
            compatible = "zmk,behavior-macro";
            #binding-cells = <0>;
            wait-ms = <MY_KANA_MACRO_WAIT_MS>;
            tap-ms = <MY_KANA_MACRO_TAP_MS>;
            bindings = <&kp S &kp I>;
        };

        my_kana_be: my_kana_be {
            compatible = "zmk,behavior-macro";
            #binding-cells = <0>;
            wait-ms = <MY_KANA_MACRO_WAIT_MS>;
            tap-ms = <MY_KANA_MACRO_TAP_MS>;
            bindings = <&kp B &kp E>;
        };

        my_kana_be_pass: my_kana_be_pass {
            compatible = "zmk,behavior-macro";
            #binding-cells = <0>;
            wait-ms = <MY_KANA_MACRO_WAIT_MS>;
            tap-ms = <MY_KANA_MACRO_TAP_MS>;
            bindings = <&kp S &kp O>;
        };

        my_kana_xe: my_kana_xe {
            compatible = "zmk,behavior-macro";
            #binding-cells = <0>;
            wait-ms = <MY_KANA_MACRO_WAIT_MS>;
            tap-ms = <MY_KANA_MACRO_TAP_MS>;
            bindings = <&kp X &kp E>;
        };

        my_kana_xe_pass: my_kana_xe_pass {
            compatible = "zmk,behavior-macro";
            #binding-cells = <0>;
            wait-ms = <MY_KANA_MACRO_WAIT_MS>;
            tap-ms = <MY_KANA_MACRO_TAP_MS>;
            bindings = <&kp S &kp P>;
        };

        my_kana_ki: my_kana_ki {
            compatible = "zmk,behavior-macro";
            #binding-cells = <0>;
            wait-ms = <MY_KANA_MACRO_WAIT_MS>;
            tap-ms = <MY_KANA_MACRO_TAP_MS>;
            bindings = <&kp K &kp I>;
        };

        my_kana_ki_pass: my_kana_ki_pass {
            compatible = "zmk,behavior-macro";
            #binding-cells = <0>;
            wait-ms = <MY_KANA_MACRO_WAIT_MS>;
            tap-ms = <MY_KANA_MACRO_TAP_MS>;
            bindings = <&kp L &kp A>;
        };

        my_kana_ri: my_kana_ri {
            compatible = "zmk,behavior-macro";
            #binding-cells = <0>;
            wait-ms = <MY_KANA_MACRO_WAIT_MS>;
            tap-ms = <MY_KANA_MACRO_TAP_MS>;
            bindings = <&kp R &kp I>;
        };

        my_kana_ri_pass: my_kana_ri_pass {
            compatible = "zmk,behavior-macro";
            #binding-cells = <0>;
            wait-ms = <MY_KANA_MACRO_WAIT_MS>;
            tap-ms = <MY_KANA_MACRO_TAP_MS>;
            bindings = <&kp L &kp S>;
        };

        my_kana_su: my_kana_su {
            compatible = "zmk,behavior-macro";
            #binding-cells = <0>;
            wait-ms = <MY_KANA_MACRO_WAIT_MS>;
            tap-ms = <MY_KANA_MACRO_TAP_MS>;
            bindings = <&kp S &kp U>;
        };

        my_kana_su_pass: my_kana_su_pass {
            compatible = "zmk,behavior-macro";
            #binding-cells = <0>;
            wait-ms = <MY_KANA_MACRO_WAIT_MS>;
            tap-ms = <MY_KANA_MACRO_TAP_MS>;
            bindings = <&kp L &kp D>;
        };

        my_kana_de: my_kana_de {
            compatible = "zmk,behavior-macro";
            #binding-cells = <0>;
            wait-ms = <MY_KANA_MACRO_WAIT_MS>;
            tap-ms = <MY_KANA_MACRO_TAP_MS>;
            bindings = <&kp D &kp E>;
        };

        my_kana_de_pass: my_kana_de_pass {
            compatible = "zmk,behavior-macro";
            #binding-cells = <0>;
            wait-ms = <MY_KANA_MACRO_WAIT_MS>;
            tap-ms = <MY_KANA_MACRO_TAP_MS>;
            bindings = <&kp L &kp F>;
        };

        my_kana_ya: my_kana_ya {
            compatible = "zmk,behavior-macro";
            #binding-cells = <0>;
            wait-ms = <MY_KANA_MACRO_WAIT_MS>;
            tap-ms = <MY_KANA_MACRO_TAP_MS>;
            bindings = <&kp Y &kp A>;
        };

        my_kana_ya_pass: my_kana_ya_pass {
            compatible = "zmk,behavior-macro";
            #binding-cells = <0>;
            wait-ms = <MY_KANA_MACRO_WAIT_MS>;
            tap-ms = <MY_KANA_MACRO_TAP_MS>;
            bindings = <&kp L &kp G>;
        };

        my_kana_ro: my_kana_ro {
            compatible = "zmk,behavior-macro";
            #binding-cells = <0>;
            wait-ms = <MY_KANA_MACRO_WAIT_MS>;
            tap-ms = <MY_KANA_MACRO_TAP_MS>;
            bindings = <&kp R &kp O>;
        };

        my_kana_ro_pass: my_kana_ro_pass {
            compatible = "zmk,behavior-macro";
            #binding-cells = <0>;
            wait-ms = <MY_KANA_MACRO_WAIT_MS>;
            tap-ms = <MY_KANA_MACRO_TAP_MS>;
            bindings = <&kp S &kp H>;
        };

        my_kana_ma: my_kana_ma {
            compatible = "zmk,behavior-macro";
            #binding-cells = <0>;
            wait-ms = <MY_KANA_MACRO_WAIT_MS>;
            tap-ms = <MY_KANA_MACRO_TAP_MS>;
            bindings = <&kp M &kp A>;
        };

        my_kana_ma_pass: my_kana_ma_pass {
            compatible = "zmk,behavior-macro";
            #binding-cells = <0>;
            wait-ms = <MY_KANA_MACRO_WAIT_MS>;
            tap-ms = <MY_KANA_MACRO_TAP_MS>;
            bindings = <&kp S &kp J>;
        };

        my_kana_mo: my_kana_mo {
            compatible = "zmk,behavior-macro";
            #binding-cells = <0>;
            wait-ms = <MY_KANA_MACRO_WAIT_MS>;
            tap-ms = <MY_KANA_MACRO_TAP_MS>;
            bindings = <&kp M &kp O>;
        };

        my_kana_mo_pass: my_kana_mo_pass {
            compatible = "zmk,behavior-macro";
            #binding-cells = <0>;
            wait-ms = <MY_KANA_MACRO_WAIT_MS>;
            tap-ms = <MY_KANA_MACRO_TAP_MS>;
            bindings = <&kp S &kp SEMI>;
        };

        my_kana_xo: my_kana_xo {
            compatible = "zmk,behavior-macro";
            #binding-cells = <0>;
            wait-ms = <MY_KANA_MACRO_WAIT_MS>;
            tap-ms = <MY_KANA_MACRO_TAP_MS>;
            bindings = <&kp X &kp O>;
        };

        my_kana_xo_pass: my_kana_xo_pass {
            compatible = "zmk,behavior-macro";
            #binding-cells = <0>;
            wait-ms = <MY_KANA_MACRO_WAIT_MS>;
            tap-ms = <MY_KANA_MACRO_TAP_MS>;
            bindings = <&kp L &kp Z>;
        };

        my_kana_pe: my_kana_pe {
            compatible = "zmk,behavior-macro";
            #binding-cells = <0>;
            wait-ms = <MY_KANA_MACRO_WAIT_MS>;
            tap-ms = <MY_KANA_MACRO_TAP_MS>;
            bindings = <&kp P &kp E>;
        };

        my_kana_pe_pass: my_kana_pe_pass {
            compatible = "zmk,behavior-macro";
            #binding-cells = <0>;
            wait-ms = <MY_KANA_MACRO_WAIT_MS>;
            tap-ms = <MY_KANA_MACRO_TAP_MS>;
            bindings = <&kp L &kp X>;
        };

        my_kana_bo: my_kana_bo {
            compatible = "zmk,behavior-macro";
            #binding-cells = <0>;
            wait-ms = <MY_KANA_MACRO_WAIT_MS>;
            tap-ms = <MY_KANA_MACRO_TAP_MS>;
            bindings = <&kp B &kp O>;
        };

        my_kana_bo_pass: my_kana_bo_pass {
            compatible = "zmk,behavior-macro";
            #binding-cells = <0>;
            wait-ms = <MY_KANA_MACRO_WAIT_MS>;
            tap-ms = <MY_KANA_MACRO_TAP_MS>;
            bindings = <&kp L &kp C>;
        };

        my_kana_he: my_kana_he {
            compatible = "zmk,behavior-macro";
            #binding-cells = <0>;
            wait-ms = <MY_KANA_MACRO_WAIT_MS>;
            tap-ms = <MY_KANA_MACRO_TAP_MS>;
            bindings = <&kp H &kp E>;
        };

        my_kana_he_pass: my_kana_he_pass {
            compatible = "zmk,behavior-macro";
            #binding-cells = <0>;
            wait-ms = <MY_KANA_MACRO_WAIT_MS>;
            tap-ms = <MY_KANA_MACRO_TAP_MS>;
            bindings = <&kp L &kp V>;
        };

        my_kana_xya: my_kana_xya {
            compatible = "zmk,behavior-macro";
            #binding-cells = <0>;
            wait-ms = <MY_KANA_MACRO_WAIT_MS>;
            tap-ms = <MY_KANA_MACRO_TAP_MS>;
            bindings = <&kp X &kp Y &kp A>;
        };

        my_kana_xya_pass: my_kana_xya_pass {
            compatible = "zmk,behavior-macro";
            #binding-cells = <0>;
            wait-ms = <MY_KANA_MACRO_WAIT_MS>;
            tap-ms = <MY_KANA_MACRO_TAP_MS>;
            bindings = <&kp L &kp B>;
        };

        my_kana_xyu: my_kana_xyu {
            compatible = "zmk,behavior-macro";
            #binding-cells = <0>;
            wait-ms = <MY_KANA_MACRO_WAIT_MS>;
            tap-ms = <MY_KANA_MACRO_TAP_MS>;
            bindings = <&kp X &kp Y &kp U>;
        };

        my_kana_xyu_pass: my_kana_xyu_pass {
            compatible = "zmk,behavior-macro";
            #binding-cells = <0>;
            wait-ms = <MY_KANA_MACRO_WAIT_MS>;
            tap-ms = <MY_KANA_MACRO_TAP_MS>;
            bindings = <&kp S &kp N>;
        };

        my_kana_mu: my_kana_mu {
            compatible = "zmk,behavior-macro";
            #binding-cells = <0>;
            wait-ms = <MY_KANA_MACRO_WAIT_MS>;
            tap-ms = <MY_KANA_MACRO_TAP_MS>;
            bindings = <&kp M &kp U>;
        };

        my_kana_mu_pass: my_kana_mu_pass {
            compatible = "zmk,behavior-macro";
            #binding-cells = <0>;
            wait-ms = <MY_KANA_MACRO_WAIT_MS>;
            tap-ms = <MY_KANA_MACRO_TAP_MS>;
            bindings = <&kp S &kp M>;
        };

        my_kana_zu: my_kana_zu {
            compatible = "zmk,behavior-macro";
            #binding-cells = <0>;
            wait-ms = <MY_KANA_MACRO_WAIT_MS>;
            tap-ms = <MY_KANA_MACRO_TAP_MS>;
            bindings = <&kp Z &kp U>;
        };

        my_kana_zu_pass: my_kana_zu_pass {
            compatible = "zmk,behavior-macro";
            #binding-cells = <0>;
            wait-ms = <MY_KANA_MACRO_WAIT_MS>;
            tap-ms = <MY_KANA_MACRO_TAP_MS>;
            bindings = <&kp S &kp COMMA>;
        };

        my_kana_thi: my_kana_thi {
            compatible = "zmk,behavior-macro";
            #binding-cells = <0>;
            wait-ms = <MY_KANA_MACRO_WAIT_MS>;
            tap-ms = <MY_KANA_MACRO_TAP_MS>;
            bindings = <&kp T &kp H &kp I>;
        };

        my_kana_thi_pass: my_kana_thi_pass {
            compatible = "zmk,behavior-macro";
            #binding-cells = <0>;
            wait-ms = <MY_KANA_MACRO_WAIT_MS>;
            tap-ms = <MY_KANA_MACRO_TAP_MS>;
            bindings = <&kp S &kp DOT>;
        };

        my_kana_xyo: my_kana_xyo {
            compatible = "zmk,behavior-macro";
            #binding-cells = <0>;
            wait-ms = <MY_KANA_MACRO_WAIT_MS>;
            tap-ms = <MY_KANA_MACRO_TAP_MS>;
            bindings = <&kp X &kp Y &kp O>;
        };

        my_kana_xyo_pass: my_kana_xyo_pass {
            compatible = "zmk,behavior-macro";
            #binding-cells = <0>;
            wait-ms = <MY_KANA_MACRO_WAIT_MS>;
            tap-ms = <MY_KANA_MACRO_TAP_MS>;
            bindings = <&kp S &kp SLASH>;
        };

        my_kana_sya: my_kana_sya {
            compatible = "zmk,behavior-macro";
            #binding-cells = <0>;
            wait-ms = <MY_KANA_MACRO_WAIT_MS>;
            tap-ms = <MY_KANA_MACRO_TAP_MS>;
            bindings = <&kp S &kp Y &kp A>;
        };

        my_kana_sya_pass: my_kana_sya_pass {
            compatible = "zmk,behavior-macro";
            #binding-cells = <0>;
            wait-ms = <MY_KANA_MACRO_WAIT_MS>;
            tap-ms = <MY_KANA_MACRO_TAP_MS>;
            bindings = <&kp E &kp M>;
        };

        my_kana_syu: my_kana_syu {
            compatible = "zmk,behavior-macro";
            #binding-cells = <0>;
            wait-ms = <MY_KANA_MACRO_WAIT_MS>;
            tap-ms = <MY_KANA_MACRO_TAP_MS>;
            bindings = <&kp S &kp Y &kp U>;
        };

        my_kana_syu_pass: my_kana_syu_pass {
            compatible = "zmk,behavior-macro";
            #binding-cells = <0>;
            wait-ms = <MY_KANA_MACRO_WAIT_MS>;
            tap-ms = <MY_KANA_MACRO_TAP_MS>;
            bindings = <&kp E &kp U>;
        };

        my_kana_syo: my_kana_syo {
            compatible = "zmk,behavior-macro";
            #binding-cells = <0>;
            wait-ms = <MY_KANA_MACRO_WAIT_MS>;
            tap-ms = <MY_KANA_MACRO_TAP_MS>;
            bindings = <&kp S &kp Y &kp O>;
        };

        my_kana_syo_pass: my_kana_syo_pass {
            compatible = "zmk,behavior-macro";
            #binding-cells = <0>;
            wait-ms = <MY_KANA_MACRO_WAIT_MS>;
            tap-ms = <MY_KANA_MACRO_TAP_MS>;
            bindings = <&kp E &kp J>;
        };

        my_kana_kya: my_kana_kya {
            compatible = "zmk,behavior-macro";
            #binding-cells = <0>;
            wait-ms = <MY_KANA_MACRO_WAIT_MS>;
            tap-ms = <MY_KANA_MACRO_TAP_MS>;
            bindings = <&kp K &kp Y &kp A>;
        };

        my_kana_kya_pass: my_kana_kya_pass {
            compatible = "zmk,behavior-macro";
            #binding-cells = <0>;
            wait-ms = <MY_KANA_MACRO_WAIT_MS>;
            tap-ms = <MY_KANA_MACRO_TAP_MS>;
            bindings = <&kp E &kp COMMA>;
        };

        my_kana_kyu: my_kana_kyu {
            compatible = "zmk,behavior-macro";
            #binding-cells = <0>;
            wait-ms = <MY_KANA_MACRO_WAIT_MS>;
            tap-ms = <MY_KANA_MACRO_TAP_MS>;
            bindings = <&kp K &kp Y &kp U>;
        };

        my_kana_kyu_pass: my_kana_kyu_pass {
            compatible = "zmk,behavior-macro";
            #binding-cells = <0>;
            wait-ms = <MY_KANA_MACRO_WAIT_MS>;
            tap-ms = <MY_KANA_MACRO_TAP_MS>;
            bindings = <&kp E &kp O>;
        };

        my_kana_kyo: my_kana_kyo {
            compatible = "zmk,behavior-macro";
            #binding-cells = <0>;
            wait-ms = <MY_KANA_MACRO_WAIT_MS>;
            tap-ms = <MY_KANA_MACRO_TAP_MS>;
            bindings = <&kp K &kp Y &kp O>;
        };

        my_kana_kyo_pass: my_kana_kyo_pass {
            compatible = "zmk,behavior-macro";
            #binding-cells = <0>;
            wait-ms = <MY_KANA_MACRO_WAIT_MS>;
            tap-ms = <MY_KANA_MACRO_TAP_MS>;
            bindings = <&kp E &kp I>;
        };

        my_kana_tya: my_kana_tya {
            compatible = "zmk,behavior-macro";
            #binding-cells = <0>;
            wait-ms = <MY_KANA_MACRO_WAIT_MS>;
            tap-ms = <MY_KANA_MACRO_TAP_MS>;
            bindings = <&kp T &kp Y &kp A>;
        };

        my_kana_tya_pass: my_kana_tya_pass {
            compatible = "zmk,behavior-macro";
            #binding-cells = <0>;
            wait-ms = <MY_KANA_MACRO_WAIT_MS>;
            tap-ms = <MY_KANA_MACRO_TAP_MS>;
            bindings = <&kp E &kp N>;
        };

        my_kana_tyu: my_kana_tyu {
            compatible = "zmk,behavior-macro";
            #binding-cells = <0>;
            wait-ms = <MY_KANA_MACRO_WAIT_MS>;
            tap-ms = <MY_KANA_MACRO_TAP_MS>;
            bindings = <&kp T &kp Y &kp U>;
        };

        my_kana_tyu_pass: my_kana_tyu_pass {
            compatible = "zmk,behavior-macro";
            #binding-cells = <0>;
            wait-ms = <MY_KANA_MACRO_WAIT_MS>;
            tap-ms = <MY_KANA_MACRO_TAP_MS>;
            bindings = <&kp E &kp Y>;
        };

        my_kana_tyo: my_kana_tyo {
            compatible = "zmk,behavior-macro";
            #binding-cells = <0>;
            wait-ms = <MY_KANA_MACRO_WAIT_MS>;
            tap-ms = <MY_KANA_MACRO_TAP_MS>;
            bindings = <&kp T &kp Y &kp O>;
        };

        my_kana_tyo_pass: my_kana_tyo_pass {
            compatible = "zmk,behavior-macro";
            #binding-cells = <0>;
            wait-ms = <MY_KANA_MACRO_WAIT_MS>;
            tap-ms = <MY_KANA_MACRO_TAP_MS>;
            bindings = <&kp E &kp H>;
        };

        my_kana_hya: my_kana_hya {
            compatible = "zmk,behavior-macro";
            #binding-cells = <0>;
            wait-ms = <MY_KANA_MACRO_WAIT_MS>;
            tap-ms = <MY_KANA_MACRO_TAP_MS>;
            bindings = <&kp H &kp Y &kp A>;
        };

        my_kana_hya_pass: my_kana_hya_pass {
            compatible = "zmk,behavior-macro";
            #binding-cells = <0>;
            wait-ms = <MY_KANA_MACRO_WAIT_MS>;
            tap-ms = <MY_KANA_MACRO_TAP_MS>;
            bindings = <&kp E &kp SLASH>;
        };

        my_kana_hyu: my_kana_hyu {
            compatible = "zmk,behavior-macro";
            #binding-cells = <0>;
            wait-ms = <MY_KANA_MACRO_WAIT_MS>;
            tap-ms = <MY_KANA_MACRO_TAP_MS>;
            bindings = <&kp H &kp Y &kp U>;
        };

        my_kana_hyu_pass: my_kana_hyu_pass {
            compatible = "zmk,behavior-macro";
            #binding-cells = <0>;
            wait-ms = <MY_KANA_MACRO_WAIT_MS>;
            tap-ms = <MY_KANA_MACRO_TAP_MS>;
            bindings = <&kp E &kp P>;
        };

        my_kana_hyo: my_kana_hyo {
            compatible = "zmk,behavior-macro";
            #binding-cells = <0>;
            wait-ms = <MY_KANA_MACRO_WAIT_MS>;
            tap-ms = <MY_KANA_MACRO_TAP_MS>;
            bindings = <&kp H &kp Y &kp O>;
        };

        my_kana_hyo_pass: my_kana_hyo_pass {
            compatible = "zmk,behavior-macro";
            #binding-cells = <0>;
            wait-ms = <MY_KANA_MACRO_WAIT_MS>;
            tap-ms = <MY_KANA_MACRO_TAP_MS>;
            bindings = <&kp E &kp SEMI>;
        };

        my_kana_ja: my_kana_ja {
            compatible = "zmk,behavior-macro";
            #binding-cells = <0>;
            wait-ms = <MY_KANA_MACRO_WAIT_MS>;
            tap-ms = <MY_KANA_MACRO_TAP_MS>;
            bindings = <&kp J &kp A>;
        };

        my_kana_ja_pass: my_kana_ja_pass {
            compatible = "zmk,behavior-macro";
            #binding-cells = <0>;
            wait-ms = <MY_KANA_MACRO_WAIT_MS>;
            tap-ms = <MY_KANA_MACRO_TAP_MS>;
            bindings = <&kp W &kp M>;
        };

        my_kana_ju: my_kana_ju {
            compatible = "zmk,behavior-macro";
            #binding-cells = <0>;
            wait-ms = <MY_KANA_MACRO_WAIT_MS>;
            tap-ms = <MY_KANA_MACRO_TAP_MS>;
            bindings = <&kp J &kp U>;
        };

        my_kana_ju_pass: my_kana_ju_pass {
            compatible = "zmk,behavior-macro";
            #binding-cells = <0>;
            wait-ms = <MY_KANA_MACRO_WAIT_MS>;
            tap-ms = <MY_KANA_MACRO_TAP_MS>;
            bindings = <&kp W &kp U>;
        };

        my_kana_jo: my_kana_jo {
            compatible = "zmk,behavior-macro";
            #binding-cells = <0>;
            wait-ms = <MY_KANA_MACRO_WAIT_MS>;
            tap-ms = <MY_KANA_MACRO_TAP_MS>;
            bindings = <&kp J &kp O>;
        };

        my_kana_jo_pass: my_kana_jo_pass {
            compatible = "zmk,behavior-macro";
            #binding-cells = <0>;
            wait-ms = <MY_KANA_MACRO_WAIT_MS>;
            tap-ms = <MY_KANA_MACRO_TAP_MS>;
            bindings = <&kp W &kp J>;
        };

        my_kana_gya: my_kana_gya {
            compatible = "zmk,behavior-macro";
            #binding-cells = <0>;
            wait-ms = <MY_KANA_MACRO_WAIT_MS>;
            tap-ms = <MY_KANA_MACRO_TAP_MS>;
            bindings = <&kp G &kp Y &kp A>;
        };

        my_kana_gya_pass: my_kana_gya_pass {
            compatible = "zmk,behavior-macro";
            #binding-cells = <0>;
            wait-ms = <MY_KANA_MACRO_WAIT_MS>;
            tap-ms = <MY_KANA_MACRO_TAP_MS>;
            bindings = <&kp W &kp COMMA>;
        };

        my_kana_gyu: my_kana_gyu {
            compatible = "zmk,behavior-macro";
            #binding-cells = <0>;
            wait-ms = <MY_KANA_MACRO_WAIT_MS>;
            tap-ms = <MY_KANA_MACRO_TAP_MS>;
            bindings = <&kp G &kp Y &kp U>;
        };

        my_kana_gyu_pass: my_kana_gyu_pass {
            compatible = "zmk,behavior-macro";
            #binding-cells = <0>;
            wait-ms = <MY_KANA_MACRO_WAIT_MS>;
            tap-ms = <MY_KANA_MACRO_TAP_MS>;
            bindings = <&kp W &kp O>;
        };

        my_kana_gyo: my_kana_gyo {
            compatible = "zmk,behavior-macro";
            #binding-cells = <0>;
            wait-ms = <MY_KANA_MACRO_WAIT_MS>;
            tap-ms = <MY_KANA_MACRO_TAP_MS>;
            bindings = <&kp G &kp Y &kp O>;
        };

        my_kana_gyo_pass: my_kana_gyo_pass {
            compatible = "zmk,behavior-macro";
            #binding-cells = <0>;
            wait-ms = <MY_KANA_MACRO_WAIT_MS>;
            tap-ms = <MY_KANA_MACRO_TAP_MS>;
            bindings = <&kp W &kp I>;
        };

        my_kana_nya: my_kana_nya {
            compatible = "zmk,behavior-macro";
            #binding-cells = <0>;
            wait-ms = <MY_KANA_MACRO_WAIT_MS>;
            tap-ms = <MY_KANA_MACRO_TAP_MS>;
            bindings = <&kp N &kp Y &kp A>;
        };

        my_kana_nya_pass: my_kana_nya_pass {
            compatible = "zmk,behavior-macro";
            #binding-cells = <0>;
            wait-ms = <MY_KANA_MACRO_WAIT_MS>;
            tap-ms = <MY_KANA_MACRO_TAP_MS>;
            bindings = <&kp W &kp N>;
        };

        my_kana_nyu: my_kana_nyu {
            compatible = "zmk,behavior-macro";
            #binding-cells = <0>;
            wait-ms = <MY_KANA_MACRO_WAIT_MS>;
            tap-ms = <MY_KANA_MACRO_TAP_MS>;
            bindings = <&kp N &kp Y &kp U>;
        };

        my_kana_nyu_pass: my_kana_nyu_pass {
            compatible = "zmk,behavior-macro";
            #binding-cells = <0>;
            wait-ms = <MY_KANA_MACRO_WAIT_MS>;
            tap-ms = <MY_KANA_MACRO_TAP_MS>;
            bindings = <&kp W &kp Y>;
        };

        my_kana_nyo: my_kana_nyo {
            compatible = "zmk,behavior-macro";
            #binding-cells = <0>;
            wait-ms = <MY_KANA_MACRO_WAIT_MS>;
            tap-ms = <MY_KANA_MACRO_TAP_MS>;
            bindings = <&kp N &kp Y &kp O>;
        };

        my_kana_nyo_pass: my_kana_nyo_pass {
            compatible = "zmk,behavior-macro";
            #binding-cells = <0>;
            wait-ms = <MY_KANA_MACRO_WAIT_MS>;
            tap-ms = <MY_KANA_MACRO_TAP_MS>;
            bindings = <&kp W &kp H>;
        };

        my_kana_bya: my_kana_bya {
            compatible = "zmk,behavior-macro";
            #binding-cells = <0>;
            wait-ms = <MY_KANA_MACRO_WAIT_MS>;
            tap-ms = <MY_KANA_MACRO_TAP_MS>;
            bindings = <&kp B &kp Y &kp A>;
        };

        my_kana_bya_pass: my_kana_bya_pass {
            compatible = "zmk,behavior-macro";
            #binding-cells = <0>;
            wait-ms = <MY_KANA_MACRO_WAIT_MS>;
            tap-ms = <MY_KANA_MACRO_TAP_MS>;
            bindings = <&kp W &kp SLASH>;
        };

        my_kana_byu: my_kana_byu {
            compatible = "zmk,behavior-macro";
            #binding-cells = <0>;
            wait-ms = <MY_KANA_MACRO_WAIT_MS>;
            tap-ms = <MY_KANA_MACRO_TAP_MS>;
            bindings = <&kp B &kp Y &kp U>;
        };

        my_kana_byu_pass: my_kana_byu_pass {
            compatible = "zmk,behavior-macro";
            #binding-cells = <0>;
            wait-ms = <MY_KANA_MACRO_WAIT_MS>;
            tap-ms = <MY_KANA_MACRO_TAP_MS>;
            bindings = <&kp W &kp P>;
        };

        my_kana_byo: my_kana_byo {
            compatible = "zmk,behavior-macro";
            #binding-cells = <0>;
            wait-ms = <MY_KANA_MACRO_WAIT_MS>;
            tap-ms = <MY_KANA_MACRO_TAP_MS>;
            bindings = <&kp B &kp Y &kp O>;
        };

        my_kana_byo_pass: my_kana_byo_pass {
            compatible = "zmk,behavior-macro";
            #binding-cells = <0>;
            wait-ms = <MY_KANA_MACRO_WAIT_MS>;
            tap-ms = <MY_KANA_MACRO_TAP_MS>;
            bindings = <&kp W &kp SEMI>;
        };

        my_kana_rya: my_kana_rya {
            compatible = "zmk,behavior-macro";
            #binding-cells = <0>;
            wait-ms = <MY_KANA_MACRO_WAIT_MS>;
            tap-ms = <MY_KANA_MACRO_TAP_MS>;
            bindings = <&kp R &kp Y &kp A>;
        };

        my_kana_rya_pass: my_kana_rya_pass {
            compatible = "zmk,behavior-macro";
            #binding-cells = <0>;
            wait-ms = <MY_KANA_MACRO_WAIT_MS>;
            tap-ms = <MY_KANA_MACRO_TAP_MS>;
            bindings = <&kp A &kp M>;
        };

        my_kana_ryu: my_kana_ryu {
            compatible = "zmk,behavior-macro";
            #binding-cells = <0>;
            wait-ms = <MY_KANA_MACRO_WAIT_MS>;
            tap-ms = <MY_KANA_MACRO_TAP_MS>;
            bindings = <&kp R &kp Y &kp U>;
        };

        my_kana_ryu_pass: my_kana_ryu_pass {
            compatible = "zmk,behavior-macro";
            #binding-cells = <0>;
            wait-ms = <MY_KANA_MACRO_WAIT_MS>;
            tap-ms = <MY_KANA_MACRO_TAP_MS>;
            bindings = <&kp A &kp U>;
        };

        my_kana_ryo: my_kana_ryo {
            compatible = "zmk,behavior-macro";
            #binding-cells = <0>;
            wait-ms = <MY_KANA_MACRO_WAIT_MS>;
            tap-ms = <MY_KANA_MACRO_TAP_MS>;
            bindings = <&kp R &kp Y &kp O>;
        };

        my_kana_ryo_pass: my_kana_ryo_pass {
            compatible = "zmk,behavior-macro";
            #binding-cells = <0>;
            wait-ms = <MY_KANA_MACRO_WAIT_MS>;
            tap-ms = <MY_KANA_MACRO_TAP_MS>;
            bindings = <&kp A &kp J>;
        };

        my_kana_mya: my_kana_mya {
            compatible = "zmk,behavior-macro";
            #binding-cells = <0>;
            wait-ms = <MY_KANA_MACRO_WAIT_MS>;
            tap-ms = <MY_KANA_MACRO_TAP_MS>;
            bindings = <&kp M &kp Y &kp A>;
        };

        my_kana_mya_pass: my_kana_mya_pass {
            compatible = "zmk,behavior-macro";
            #binding-cells = <0>;
            wait-ms = <MY_KANA_MACRO_WAIT_MS>;
            tap-ms = <MY_KANA_MACRO_TAP_MS>;
            bindings = <&kp A &kp COMMA>;
        };

        my_kana_myu: my_kana_myu {
            compatible = "zmk,behavior-macro";
            #binding-cells = <0>;
            wait-ms = <MY_KANA_MACRO_WAIT_MS>;
            tap-ms = <MY_KANA_MACRO_TAP_MS>;
            bindings = <&kp M &kp Y &kp U>;
        };

        my_kana_myu_pass: my_kana_myu_pass {
            compatible = "zmk,behavior-macro";
            #binding-cells = <0>;
            wait-ms = <MY_KANA_MACRO_WAIT_MS>;
            tap-ms = <MY_KANA_MACRO_TAP_MS>;
            bindings = <&kp A &kp O>;
        };

        my_kana_myo: my_kana_myo {
            compatible = "zmk,behavior-macro";
            #binding-cells = <0>;
            wait-ms = <MY_KANA_MACRO_WAIT_MS>;
            tap-ms = <MY_KANA_MACRO_TAP_MS>;
            bindings = <&kp M &kp Y &kp O>;
        };

        my_kana_myo_pass: my_kana_myo_pass {
            compatible = "zmk,behavior-macro";
            #binding-cells = <0>;
            wait-ms = <MY_KANA_MACRO_WAIT_MS>;
            tap-ms = <MY_KANA_MACRO_TAP_MS>;
            bindings = <&kp A &kp I>;
        };

        my_kana_vi: my_kana_vi {
            compatible = "zmk,behavior-macro";
            #binding-cells = <0>;
            wait-ms = <MY_KANA_MACRO_WAIT_MS>;
            tap-ms = <MY_KANA_MACRO_TAP_MS>;
            bindings = <&kp V &kp I>;
        };

        my_kana_vi_pass: my_kana_vi_pass {
            compatible = "zmk,behavior-macro";
            #binding-cells = <0>;
            wait-ms = <MY_KANA_MACRO_WAIT_MS>;
            tap-ms = <MY_KANA_MACRO_TAP_MS>;
            bindings = <&kp A &kp N>;
        };

        my_kana_va: my_kana_va {
            compatible = "zmk,behavior-macro";
            #binding-cells = <0>;
            wait-ms = <MY_KANA_MACRO_WAIT_MS>;
            tap-ms = <MY_KANA_MACRO_TAP_MS>;
            bindings = <&kp V &kp A>;
        };

        my_kana_va_pass: my_kana_va_pass {
            compatible = "zmk,behavior-macro";
            #binding-cells = <0>;
            wait-ms = <MY_KANA_MACRO_WAIT_MS>;
            tap-ms = <MY_KANA_MACRO_TAP_MS>;
            bindings = <&kp A &kp Y>;
        };

        my_kana_che: my_kana_che {
            compatible = "zmk,behavior-macro";
            #binding-cells = <0>;
            wait-ms = <MY_KANA_MACRO_WAIT_MS>;
            tap-ms = <MY_KANA_MACRO_TAP_MS>;
            bindings = <&kp C &kp H &kp E>;
        };

        my_kana_che_pass: my_kana_che_pass {
            compatible = "zmk,behavior-macro";
            #binding-cells = <0>;
            wait-ms = <MY_KANA_MACRO_WAIT_MS>;
            tap-ms = <MY_KANA_MACRO_TAP_MS>;
            bindings = <&kp A &kp H>;
        };

        my_kana_pya: my_kana_pya {
            compatible = "zmk,behavior-macro";
            #binding-cells = <0>;
            wait-ms = <MY_KANA_MACRO_WAIT_MS>;
            tap-ms = <MY_KANA_MACRO_TAP_MS>;
            bindings = <&kp P &kp Y &kp A>;
        };

        my_kana_pya_pass: my_kana_pya_pass {
            compatible = "zmk,behavior-macro";
            #binding-cells = <0>;
            wait-ms = <MY_KANA_MACRO_WAIT_MS>;
            tap-ms = <MY_KANA_MACRO_TAP_MS>;
            bindings = <&kp A &kp SLASH>;
        };

        my_kana_pyu: my_kana_pyu {
            compatible = "zmk,behavior-macro";
            #binding-cells = <0>;
            wait-ms = <MY_KANA_MACRO_WAIT_MS>;
            tap-ms = <MY_KANA_MACRO_TAP_MS>;
            bindings = <&kp P &kp Y &kp U>;
        };

        my_kana_pyu_pass: my_kana_pyu_pass {
            compatible = "zmk,behavior-macro";
            #binding-cells = <0>;
            wait-ms = <MY_KANA_MACRO_WAIT_MS>;
            tap-ms = <MY_KANA_MACRO_TAP_MS>;
            bindings = <&kp A &kp P>;
        };

        my_kana_pyo: my_kana_pyo {
            compatible = "zmk,behavior-macro";
            #binding-cells = <0>;
            wait-ms = <MY_KANA_MACRO_WAIT_MS>;
            tap-ms = <MY_KANA_MACRO_TAP_MS>;
            bindings = <&kp P &kp Y &kp O>;
        };

        my_kana_pyo_pass: my_kana_pyo_pass {
            compatible = "zmk,behavior-macro";
            #binding-cells = <0>;
            wait-ms = <MY_KANA_MACRO_WAIT_MS>;
            tap-ms = <MY_KANA_MACRO_TAP_MS>;
            bindings = <&kp A &kp SEMI>;
        };

        my_kana_fi: my_kana_fi {
            compatible = "zmk,behavior-macro";
            #binding-cells = <0>;
            wait-ms = <MY_KANA_MACRO_WAIT_MS>;
            tap-ms = <MY_KANA_MACRO_TAP_MS>;
            bindings = <&kp F &kp I>;
        };

        my_kana_fi_pass: my_kana_fi_pass {
            compatible = "zmk,behavior-macro";
            #binding-cells = <0>;
            wait-ms = <MY_KANA_MACRO_WAIT_MS>;
            tap-ms = <MY_KANA_MACRO_TAP_MS>;
            bindings = <&kp Z &kp U>;
        };

        my_kana_fa: my_kana_fa {
            compatible = "zmk,behavior-macro";
            #binding-cells = <0>;
            wait-ms = <MY_KANA_MACRO_WAIT_MS>;
            tap-ms = <MY_KANA_MACRO_TAP_MS>;
            bindings = <&kp F &kp A>;
        };

        my_kana_fa_pass: my_kana_fa_pass {
            compatible = "zmk,behavior-macro";
            #binding-cells = <0>;
            wait-ms = <MY_KANA_MACRO_WAIT_MS>;
            tap-ms = <MY_KANA_MACRO_TAP_MS>;
            bindings = <&kp Z &kp J>;
        };

        my_kana_fo: my_kana_fo {
            compatible = "zmk,behavior-macro";
            #binding-cells = <0>;
            wait-ms = <MY_KANA_MACRO_WAIT_MS>;
            tap-ms = <MY_KANA_MACRO_TAP_MS>;
            bindings = <&kp F &kp O>;
        };

        my_kana_fo_pass: my_kana_fo_pass {
            compatible = "zmk,behavior-macro";
            #binding-cells = <0>;
            wait-ms = <MY_KANA_MACRO_WAIT_MS>;
            tap-ms = <MY_KANA_MACRO_TAP_MS>;
            bindings = <&kp Z &kp M>;
        };

        my_kana_she: my_kana_she {
            compatible = "zmk,behavior-macro";
            #binding-cells = <0>;
            wait-ms = <MY_KANA_MACRO_WAIT_MS>;
            tap-ms = <MY_KANA_MACRO_TAP_MS>;
            bindings = <&kp S &kp H &kp E>;
        };

        my_kana_she_pass: my_kana_she_pass {
            compatible = "zmk,behavior-macro";
            #binding-cells = <0>;
            wait-ms = <MY_KANA_MACRO_WAIT_MS>;
            tap-ms = <MY_KANA_MACRO_TAP_MS>;
            bindings = <&kp Z &kp I>;
        };

        my_kana_je: my_kana_je {
            compatible = "zmk,behavior-macro";
            #binding-cells = <0>;
            wait-ms = <MY_KANA_MACRO_WAIT_MS>;
            tap-ms = <MY_KANA_MACRO_TAP_MS>;
            bindings = <&kp J &kp E>;
        };

        my_kana_je_pass: my_kana_je_pass {
            compatible = "zmk,behavior-macro";
            #binding-cells = <0>;
            wait-ms = <MY_KANA_MACRO_WAIT_MS>;
            tap-ms = <MY_KANA_MACRO_TAP_MS>;
            bindings = <&kp Z &kp COMMA>;
        };

        my_kana_twu: my_kana_twu {
            compatible = "zmk,behavior-macro";
            #binding-cells = <0>;
            wait-ms = <MY_KANA_MACRO_WAIT_MS>;
            tap-ms = <MY_KANA_MACRO_TAP_MS>;
            bindings = <&kp T &kp W &kp U>;
        };

        my_kana_twu_pass: my_kana_twu_pass {
            compatible = "zmk,behavior-macro";
            #binding-cells = <0>;
            wait-ms = <MY_KANA_MACRO_WAIT_MS>;
            tap-ms = <MY_KANA_MACRO_TAP_MS>;
            bindings = <&kp Z &kp O>;
        };

        my_kana_dwu: my_kana_dwu {
            compatible = "zmk,behavior-macro";
            #binding-cells = <0>;
            wait-ms = <MY_KANA_MACRO_WAIT_MS>;
            tap-ms = <MY_KANA_MACRO_TAP_MS>;
            bindings = <&kp D &kp W &kp U>;
        };

        my_kana_dwu_pass: my_kana_dwu_pass {
            compatible = "zmk,behavior-macro";
            #binding-cells = <0>;
            wait-ms = <MY_KANA_MACRO_WAIT_MS>;
            tap-ms = <MY_KANA_MACRO_TAP_MS>;
            bindings = <&kp Z &kp DOT>;
        };

        my_kana_wi: my_kana_wi {
            compatible = "zmk,behavior-macro";
            #binding-cells = <0>;
            wait-ms = <MY_KANA_MACRO_WAIT_MS>;
            tap-ms = <MY_KANA_MACRO_TAP_MS>;
            bindings = <&kp W &kp I>;
        };

        my_kana_wi_pass: my_kana_wi_pass {
            compatible = "zmk,behavior-macro";
            #binding-cells = <0>;
            wait-ms = <MY_KANA_MACRO_WAIT_MS>;
            tap-ms = <MY_KANA_MACRO_TAP_MS>;
            bindings = <&kp Z &kp P>;
        };

        my_kana_we: my_kana_we {
            compatible = "zmk,behavior-macro";
            #binding-cells = <0>;
            wait-ms = <MY_KANA_MACRO_WAIT_MS>;
            tap-ms = <MY_KANA_MACRO_TAP_MS>;
            bindings = <&kp W &kp E>;
        };

        my_kana_we_pass: my_kana_we_pass {
            compatible = "zmk,behavior-macro";
            #binding-cells = <0>;
            wait-ms = <MY_KANA_MACRO_WAIT_MS>;
            tap-ms = <MY_KANA_MACRO_TAP_MS>;
            bindings = <&kp Z &kp SEMI>;
        };

        my_kana_who: my_kana_who {
            compatible = "zmk,behavior-macro";
            #binding-cells = <0>;
            wait-ms = <MY_KANA_MACRO_WAIT_MS>;
            tap-ms = <MY_KANA_MACRO_TAP_MS>;
            bindings = <&kp W &kp H &kp O>;
        };

        my_kana_who_pass: my_kana_who_pass {
            compatible = "zmk,behavior-macro";
            #binding-cells = <0>;
            wait-ms = <MY_KANA_MACRO_WAIT_MS>;
            tap-ms = <MY_KANA_MACRO_TAP_MS>;
            bindings = <&kp Z &kp SLASH>;
        };

        my_kana_ve: my_kana_ve {
            compatible = "zmk,behavior-macro";
            #binding-cells = <0>;
            wait-ms = <MY_KANA_MACRO_WAIT_MS>;
            tap-ms = <MY_KANA_MACRO_TAP_MS>;
            bindings = <&kp V &kp E>;
        };

        my_kana_ve_pass: my_kana_ve_pass {
            compatible = "zmk,behavior-macro";
            #binding-cells = <0>;
            wait-ms = <MY_KANA_MACRO_WAIT_MS>;
            tap-ms = <MY_KANA_MACRO_TAP_MS>;
            bindings = <&kp Z &kp Y>;
        };

        my_kana_fe: my_kana_fe {
            compatible = "zmk,behavior-macro";
            #binding-cells = <0>;
            wait-ms = <MY_KANA_MACRO_WAIT_MS>;
            tap-ms = <MY_KANA_MACRO_TAP_MS>;
            bindings = <&kp F &kp E>;
        };

        my_kana_fe_pass: my_kana_fe_pass {
            compatible = "zmk,behavior-macro";
            #binding-cells = <0>;
            wait-ms = <MY_KANA_MACRO_WAIT_MS>;
            tap-ms = <MY_KANA_MACRO_TAP_MS>;
            bindings = <&kp Z &kp H>;
        };

        my_kana_vo: my_kana_vo {
            compatible = "zmk,behavior-macro";
            #binding-cells = <0>;
            wait-ms = <MY_KANA_MACRO_WAIT_MS>;
            tap-ms = <MY_KANA_MACRO_TAP_MS>;
            bindings = <&kp V &kp O>;
        };

        my_kana_vo_pass: my_kana_vo_pass {
            compatible = "zmk,behavior-macro";
            #binding-cells = <0>;
            wait-ms = <MY_KANA_MACRO_WAIT_MS>;
            tap-ms = <MY_KANA_MACRO_TAP_MS>;
            bindings = <&kp Z &kp N>;
        };

