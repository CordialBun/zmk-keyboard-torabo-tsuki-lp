## Kconfig
```kconfig
config LOGOS_KANA
    bool "Enable Logos Kana behavior"
    default y

config LOGOS_KANA_COMBO_TIMEOUT_MS
    int "Logos Kana combo timeout in milliseconds"
    depends on LOGOS_KANA
    default 60
```

## dts/bindings/behaviors/zmk,behavior-logos-kana.yaml
```yaml
# SPDX-License-Identifier: MIT

description: Logos Kana behavior

compatible: "zmk,behavior-logos-kana"

include: two_param.yaml
```
